## conf/layer.conf
```bitbake
BBPATH .= ":${LAYERDIR}"

# We have recipes-* directories, add to BBFILES
BBFILES += "${LAYERDIR}/recipes-*/*/*.bb \
            ${LAYERDIR}/recipes-*/*/*.bbappend"

BBFILE_COLLECTIONS += "meta-hyni"
BBFILE_PATTERN_meta-hyni = "^${LAYERDIR}/"
BBFILE_PRIORITY_meta-hyni = "6"

LAYERDEPENDS_meta-hyni = "core openembedded-layer qt6-layer"
LAYERSERIES_COMPAT_meta-hyni = "kirkstone langdale mickledore nanbield scarthgap"

# Layer version
LAYERVERSION_meta-hyni = "1"

# Additional configuration
PREFERRED_PROVIDER_virtual/hyni = "hyni"

# Default schema path for embedded systems
HYNI_SCHEMA_PATH ??= "${datadir}/hyni/schemas"
HYNI_CONFIG_PATH ??= "${sysconfdir}/hyni"

# Feature flags for embedded builds
HYNI_FEATURES ??= "streaming validation caching"
HYNI_DISABLE_FEATURES ??= ""

# Resource limits for embedded systems
HYNI_MAX_CACHE_SIZE ??= "50"
HYNI_MAX_MESSAGE_HISTORY ??= "100"
HYNI_DEFAULT_TIMEOUT ??= "30000"

# Qt configuration for UI
QT_EDITION ??= "opensource"
PREFERRED_VERSION_qtbase ??= "6.%"
```

## conf/local.conf
```bitbake
# Enable required features
DISTRO_FEATURES_append = " x11 opengl wayland systemd"

# Qt configuration
QT_EDITION = "opensource"
PREFERRED_VERSION_qtbase = "6.%"

# Machine configuration (example for qemux86-64)
MACHINE ??= "qemux86-64"

# QEMU memory settings - Remove from here as it should be in image recipe
QB_MEM = "-m 8192"

# Ensure kernel sees all memory
APPEND += "mem=8192M"

# Enable hyni features
HYNI_FEATURES = "streaming validation caching ui"
HYNI_DISABLE_FEATURES = ""

# Resource configuration for desktop
HYNI_MAX_CACHE_SIZE = "100"
HYNI_MAX_MESSAGE_HISTORY = "500"
HYNI_DEFAULT_TIMEOUT = "30000"

# Image configuration
IMAGE_ROOTFS_SIZE = "4096"
IMAGE_ROOTFS_EXTRA_SPACE = "2048"

# Development configuration
EXTRA_IMAGE_FEATURES = "debug-tweaks tools-sdk dev-pkgs"

# Optional: Set API keys (use with caution in production)
# HYNI_OPENAI_API_KEY = "your-openai-key"
# HYNI_CLAUDE_API_KEY = "your-claude-key"
```
